## prj.conf
```kconfig
CONFIG_SFCB=y
CONFIG_SFCB_WBS=4
CONFIG_SFCB_ATE_CACHE_SIZE=1
CONFIG_SFCB_LOG_LEVEL_INF=y
CONFIG_SETTINGS=y
CONFIG_SETTINGS_CUSTOM=y
CONFIG_SETTINGS_SFCB=y
CONFIG_SETTINGS_SFCB_DEFAULT=y
CONFIG_LOG=y
CONFIG_LOG_MINIMAL=y
```

## prj_nrf51_pca10028.conf
```kconfig
CONFIG_FLASH=y
CONFIG_FLASH_PAGE_LAYOUT=y
CONFIG_SFCB=y
CONFIG_SFCB_FLASH_SUPPORTS_UNALIGNED_WRITE=y
CONFIG_SFCB_FLASH_SUPPORTS_UNALIGNED_READ=y
CONFIG_SFCB_WBS=4
CONFIG_SFCB_ATE_CACHE_SIZE=1
CONFIG_SFCB_LOG_LEVEL_INF=y
CONFIG_SETTINGS=y
CONFIG_SETTINGS_CUSTOM=y
CONFIG_SETTINGS_SFCB=y
CONFIG_SETTINGS_SFCB_DEFAULT=y
CONFIG_LOG=y
CONFIG_LOG_IMMEDIATE=y
```

## prj_nrf52_pca10040.conf
```kconfig
CONFIG_FLASH=y
CONFIG_FLASH_PAGE_LAYOUT=y
CONFIG_ARM_MPU=n
CONFIG_SFCB=y
CONFIG_SFCB_FLASH_SUPPORTS_UNALIGNED_WRITE=y
CONFIG_SFCB_FLASH_SUPPORTS_UNALIGNED_READ=y
CONFIG_SFCB_WBS=4
CONFIG_SFCB_ATE_CACHE_SIZE=1
CONFIG_SFCB_LOG_LEVEL_INF=y
CONFIG_SETTINGS=y
CONFIG_SETTINGS_CUSTOM=y
CONFIG_SETTINGS_SFCB=y
CONFIG_SETTINGS_SFCB_DEFAULT=y
CONFIG_LOG=y
CONFIG_LOG_IMMEDIATE=y
```

## src/main.c
```c
/*
 * Copyright (c) 2019 Laczen
 *
 * SPDX-License-Identifier: Apache-2.0
 */
#include <settings_sfcb.h>
#include <string.h>

u32_t boot_count=0;

static int set(const char *name, size_t len, settings_read_cb read_cb,
		  void *cb_arg)
{
	int rc;
	const char *next;

    if (settings_name_steq(name, "bc", &next) && !next) {
		rc = read_cb(cb_arg, &boot_count, sizeof(boot_count));
		return 0;
	}
	return -ENOENT;
}

SETTINGS_STATIC_HANDLER_DEFINE(ps, "ps", NULL, set, NULL, NULL);

extern sfcb_fs settings_sfcb;
// entry point
int main(void) {
    int rc, cnt;

    rc = settings_subsys_init();

    for (cnt = 0; cnt < 8; cnt++) {
        boot_count = 0;
        settings_load();
        boot_count +=1;
        rc = settings_save_one("ps/bc", &boot_count, sizeof(boot_count));

        // print the boot count
        printk("bootcount: %d\n", boot_count);
    }

    while (settings_sfcb.wr_sector != (settings_sfcb.sector_cnt - 1)) {
        rc = settings_save_one("ps/bd", &boot_count, sizeof(boot_count));
    }

    boot_count = 0;
    settings_load();
    printk("bootcount: %d\n", boot_count);

    /* test delete */
    rc = settings_delete("ps/bc");
    boot_count = 0;
    settings_load();
    printk("bootcount: %d\n", boot_count);

    return 0;
}
```
