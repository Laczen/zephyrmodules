## prj.conf
```kconfig
CONFIG_USE_DT_CODE_PARTITION=y
CONFIG_ZB_EIGHT=y
CONFIG_ZB_EIGHT_IS_FSL=y

CONFIG_ARM_MPU=n
CONFIG_FLASH=y
CONFIG_FLASH_PAGE_LAYOUT=n
CONFIG_ENTROPY_GENERATOR=n

# Drivers and peripherals
CONFIG_I2C=n
CONFIG_WATCHDOG=n
CONFIG_GPIO=n
CONFIG_PINMUX=n
CONFIG_SPI=n
CONFIG_USE_SEGGER_RTT=n

# Power management
CONFIG_SYS_POWER_MANAGEMENT=n

# Interrupts
CONFIG_DYNAMIC_INTERRUPTS=n
CONFIG_IRQ_OFFLOAD=n

# Memory protection
# CONFIG_MEMORY_PROTECTION=n
CONFIG_THREAD_STACK_INFO=n
CONFIG_THREAD_CUSTOM_DATA=n
CONFIG_FLOAT=n

# Boot
CONFIG_BOOT_BANNER=n
CONFIG_BOOT_DELAY=0

# Console
CONFIG_LOG=y
CONFIG_LOG_MINIMAL=y
CONFIG_ZB_EIGHT_LOG_LEVEL_OFF=y
#CONFIG_SERIAL=n
#CONFIG_CONSOLE=n
#CONFIG_UART_CONSOLE=n
#CONFIG_PRINTK=n

CONFIG_EARLY_CONSOLE=n
CONFIG_STDOUT_CONSOLE=n

# Build
CONFIG_SIZE_OPTIMIZATIONS=y

# No timer support in the kernel
CONFIG_CLOCK_CONTROL_MCUX_CCM=n
CONFIG_CLOCK_CONTROL_MCUX_MCG=n
CONFIG_CLOCK_CONTROL_MCUX_PCC=n
CONFIG_CLOCK_CONTROL_MCUX_SCG=n
CONFIG_CLOCK_CONTROL_MCUX_SIM=n
CONFIG_CLOCK_CONTROL=n
CONFIG_SYS_CLOCK_EXISTS=n
CONFIG_MULTITHREADING=n
CONFIG_NUM_PREEMPT_PRIORITIES=0
```

## fsl.overlay
```dts
/*
 * Copyright (c) 2019 Laczen
 *
 * SPDX-License-Identifier: Apache-2.0
 */

/ {
	chosen {
		zephyr,code-partition = &fsl_partition;
	};
};
```

## src/main.c
```c
/*
 * Copyright (c) 2019 Laczen
 *
 * SPDX-License-Identifier: Apache-2.0
 */
#include <zb8/zb8_fsl.h>
#include <logging/log.h>
LOG_MODULE_REGISTER(main, CONFIG_LOG_DEFAULT_LEVEL);

void main(void)
{
	LOG_INF("Welcome to ZB-8 first stage loader");
	zb_fsl_boot();
	/* You should not get here */
	LOG_ERR("Starting failed, try reset");
}
```
