## prj.conf
```kconfig
#CONFIG_HAS_FLASH_LOAD_OFFSET=y
CONFIG_USE_DT_CODE_PARTITION=y
CONFIG_TEXT_SECTION_OFFSET=0x200
CONFIG_ZB_EIGHT=y
CONFIG_ZB_EIGHT_IS_BOOTLOADER=y

CONFIG_ARM=y
CONFIG_ARM_MPU=n

CONFIG_I2C=n
CONFIG_WATCHDOG=n
CONFIG_GPIO=n
CONFIG_PINMUX=n
CONFIG_SPI=n
CONFIG_SYS_POWER_MANAGEMENT=n
CONFIG_BT=n

CONFIG_ARM=y
CONFIG_ARM_MPU=n

CONFIG_BOOT_BANNER=n
CONFIG_BOOT_DELAY=0
CONFIG_DEBUG=n

# Console
CONFIG_LOG=y
CONFIG_LOG_MINIMAL=y
#CONFIG_CONSOLE=n
#CONFIG_EARLY_CONSOLE=n
#CONFIG_UART_CONSOLE=n
#CONFIG_STDOUT_CONSOLE=n
#CONFIG_PRINTK=n
#CONFIG_SERIAL=n

CONFIG_MULTITHREADING=n
CONFIG_NUM_PREEMPT_PRIORITIES=0
CONFIG_SYS_CLOCK_EXISTS=n
```

## boot.overlay
```dts
/*
 * Copyright (c) 2019 Laczen
 *
 * SPDX-License-Identifier: Apache-2.0
 */

/ {
	chosen {
		zephyr,code-partition = &boot_partition;
	};
};
```

## src/main.c
```c
/*
 * Copyright (c) 2019 LaczenJMS.
 *
 * SPDX-License-Identifier: Apache-2.0
 */

#include <zephyr.h>
#include <zb8/zb8_move.h>
#include <zb8/zb8_image.h>
#include <zb8/zb8_fsl.h>

#include <logging/log.h>
LOG_MODULE_REGISTER(main);

void main(void)
{
	u8_t cnt;
	struct zb_slt_info run_slt;
	struct zb_img_info run;

	LOG_INF("Welcome to ZB-8 swapper");

	cnt = zb_slt_area_cnt();

	/* Start or continue swap */
	while ((cnt--) > 0) {
		(void)zb_img_swap(cnt);
	}

	/* Get info from run_0 image */
	(void)zb_slt_open(&run_slt, 0, RUN);
	(void)zb_get_img_info(&run, &run_slt);

	/* If image in slot 0 is a bootloader call FSL */
	if (run.is_bootloader) {
		LOG_INF("Restarting FSL to upgrade bootloader");
		zb_fsl_jump_fsl();
	}

	/* TODO Add support for RAM images */

	/* Otherwise start the image */
	LOG_INF("Starting the image in run 0 slot");
	zb_fsl_jump_run();
}
```
