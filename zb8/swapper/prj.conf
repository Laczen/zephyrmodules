## prj.conf
```kconfig
#CONFIG_HAS_FLASH_LOAD_OFFSET=y
CONFIG_USE_DT_CODE_PARTITION=y
CONFIG_TEXT_SECTION_OFFSET=0x200
CONFIG_ZB_EIGHT=y
CONFIG_ZB_EIGHT_IS_SWAPPER=y

CONFIG_ARM_MPU=n
CONFIG_FLASH=y

CONFIG_I2C=n
CONFIG_WATCHDOG=n
CONFIG_GPIO=n
CONFIG_PINMUX=n
CONFIG_SPI=n
CONFIG_SYS_POWER_MANAGEMENT=n
CONFIG_BT=n

CONFIG_BOOT_BANNER=n
CONFIG_BOOT_DELAY=0

# Console
CONFIG_LOG=y
CONFIG_LOG_MINIMAL=y
CONFIG_ZB_EIGHT_LOG_LEVEL_OFF=y
#CONFIG_CONSOLE=n
#CONFIG_EARLY_CONSOLE=n
#CONFIG_UART_CONSOLE=n
#CONFIG_STDOUT_CONSOLE=n
#CONFIG_PRINTK=n
#CONFIG_SERIAL=n

CONFIG_MULTITHREADING=n
CONFIG_NUM_PREEMPT_PRIORITIES=0
CONFIG_SYS_CLOCK_EXISTS=n
```

## swapper.overlay
```dts
/*
 * Copyright (c) 2019 Laczen
 *
 * SPDX-License-Identifier: Apache-2.0
 */

/ {
	chosen {
		zephyr,code-partition = &swpr_partition;
	};
};
```

## src/main.c
```c
/*
 * Copyright (c) 2019 LaczenJMS.
 *
 * SPDX-License-Identifier: Apache-2.0
 */

#include <zephyr.h>
#include <zb8/zb8_move.h>
#include <zb8/zb8_flash.h>
#include <zb8/zb8_fsl.h>

#include <logging/log.h>
LOG_MODULE_REGISTER(main);

void main(void)
{
	u8_t cnt;
	int rc;
	struct zb_slt_info run;
	struct zb_fsl_hdr hdr;

	LOG_INF("Welcome to ZB-8 swapper");

	cnt = zb_slt_area_cnt();

	/* Start or continue swap */
	while ((cnt--) > 1) {
		rc = zb_img_swap(cnt);
		if (rc) {
			LOG_INF("Swap failed for slot %u [%d]", cnt, rc);
		}
	}

	rc = zb_img_swap(0);
	if (!rc) {
		/* Get info from run_0 image */
		(void)zb_slt_open(&run, 0, RUN);
		(void)zb_read(&run, 0U, &hdr, sizeof(struct zb_fsl_hdr));

		if (hdr.magic == FSL_MAGIC) {

			hdr.run_offset -= hdr.hdr_info.size;
			if ((hdr.run_offset == DT_FLASH_AREA_SWPR_OFFSET) ||
			    (hdr.run_offset == DT_FLASH_AREA_LDR_OFFSET)) {
				LOG_INF("Restarting for swapper/loader update");
				zb_fsl_jump_fsl();
			}
		}

	} else {
		LOG_INF("Swap failed for slot 0 [%d]", rc);
	}

	if (rc && zb_inplace_slt(0)) {
		LOG_INF("Falling back to loader image");
		zb_fsl_jump_ldr();
	}

	/* TODO Add support for RAM images */
	zb_fsl_jump_run();

	LOG_ERR("Starting failed, try reset");

}
```
