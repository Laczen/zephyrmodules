## CMakeLists.txt
```
# SPDX-License-Identifier: Apache-2.0

cmake_minimum_required(VERSION 3.13.1)
include($ENV{ZEPHYR_BASE}/cmake/app/boilerplate.cmake NO_POLICY_SCOPE)

project(test_sfcb)

FILE(GLOB app_sources src/*.c)

target_sources(app PRIVATE ${app_sources})
```

## prj.conf
```kconfig
CONFIG_SFCB=y
CONFIG_SFCB_WBS=4
CONFIG_SFCB_ATE_CACHE_SIZE=1
CONFIG_SFCB_LOG_LEVEL_INF=y
CONFIG_LOG=y
CONFIG_LOG_MINIMAL=y
```

## prj_nrf51_pca10028.conf
```kconfig
CONFIG_FLASH=y
CONFIG_FLASH_PAGE_LAYOUT=y
CONFIG_SFCB=y
CONFIG_SFCB_FLASH_SUPPORTS_UNALIGNED_WRITE=y
CONFIG_SFCB_FLASH_SUPPORTS_UNALIGNED_READ=y
CONFIG_SFCB_WBS=4
CONFIG_SFCB_ATE_CACHE_SIZE=1
CONFIG_SFCB_LOG_LEVEL_INF=y
CONFIG_LOG=y
CONFIG_LOG_IMMEDIATE=y
```

## prj_nrf52_pca10040.conf
```kconfig
CONFIG_FLASH=y
CONFIG_FLASH_PAGE_LAYOUT=y
CONFIG_ARM_MPU=n
CONFIG_SFCB=y
CONFIG_SFCB_FLASH_SUPPORTS_UNALIGNED_WRITE=y
CONFIG_SFCB_FLASH_SUPPORTS_UNALIGNED_READ=y
CONFIG_SFCB_WBS=4
CONFIG_SFCB_ATE_CACHE_SIZE=1
CONFIG_SFCB_LOG_LEVEL_INF=y
CONFIG_LOG=y
CONFIG_LOG_IMMEDIATE=y
```

## src/main.c
```c
/*
 * Copyright (c) 2019 Laczen
 *
 * SPDX-License-Identifier: Apache-2.0
 */
#include <sfcb.h>
#include <string.h>

// variables used by the filesystem
sfcb_fs sfcb;

// configuration of the filesystem is provided by this struct
const sfcb_fs_cfg cfg = {
	.offset = DT_FLASH_AREA_STORAGE_OFFSET,
	.size = DT_FLASH_AREA_STORAGE_SIZE,
	.dev_name = DT_FLASH_AREA_STORAGE_DEV,
};

// entry point
int main(void) {
    // mount the filesystem
    int rc;
    u32_t boot_count = 0;
    sfcb_loc loc;
    sfcb_ate *ate;

    sfcb.cfg = &cfg;
    rc = sfcb_mount(&sfcb);

    // reformat if we can't mount the filesystem
    if (rc) {
        sfcb_format(&sfcb);
        sfcb_mount(&sfcb);
    }

    // read current count
    if (!sfcb_start_loc(&sfcb, &loc)) {
        while (!sfcb_next_loc(&loc)) {
            ate = sfcb_get_ate(&loc);
            if (ate->id == 0) {
                sfcb_read_loc(&loc, &boot_count, sizeof(boot_count));
            }
        }
    }

    // update boot count
    boot_count += 1;
    if (!sfcb_open_loc(&sfcb, &loc, 0, sizeof(boot_count))) {
        (void)sfcb_write_loc(&loc, &boot_count, sizeof(boot_count));
        // remember the storage is not updated until the location is closed
        (void)sfcb_close_loc(&loc);
    }

    // release any resources we were using
    sfcb_unmount(&sfcb);

    // print the boot count
    printk("bootcount: %d\n", boot_count);
    return 0;
}
```
