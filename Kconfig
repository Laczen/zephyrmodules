## Kconfig
```kconfig
# Kconfig - Subsystem configuration options
#
# Copyright (c) 2019 Laczen
#
# SPDX-License-Identifier: Apache-2.0
#

rsource "./sfcb/Kconfig"
rsource "./settings_sfcb/Kconfig"
rsource "./zb8/Kconfig"
```

## settings_sfcb/Kconfig
```kconfig
# Kconfig - Settings - SFCB Backend
#
# Copyright (c) 2019 Laczen
#
# SPDX-License-Identifier: Apache-2.0
#

config SETTINGS_SFCB
	bool "Settings - SFCB Backend"
	depends on SETTINGS && SFCB
	help
	  Enable support of SFCB Backend for settings.

if SETTINGS_SFCB

module = SETTINGS_SFCB
module-str = settings_sfcb
source "subsys/logging/Kconfig.template.log_config"

config SETTINGS_SFCB_DEFAULT
	bool "Enable a default SFCB backend for settings"
	depends on SETTINGS_CUSTOM
	default y
	help
	  Prepare a default backend for settings storage

endif #SETTINGS_SFCB
```

## sfcb/Kconfig
```kconfig
# Kconfig - Simple/Secure/Small Flash Circular Buffer - SFCB
#
# Copyright (c) 2019 Laczen
#
# SPDX-License-Identifier: Apache-2.0
#

config SFCB
	bool "Simple/Secure/Small Flash Circular Buffer - SFCB"
	help
	  Enable support of SFCB.

if SFCB

module = SFCB
module-str = sfcb
source "subsys/logging/Kconfig.template.log_config"

config SFCB_WBS
	int "SFCB write block size"
	range 1 128
	default 8
	help
	  SFCB will align writes to this size, it should be a power of 2 and a
	  multiple of the flash device write block size. Set it as low as
	  possible to reduce stack usage and to maximize flash utilization.

config SFCB_ATE_CACHE_SIZE
	int "SFCB ATE cache size (ATE count)"
	range 1 32
	default 1
	help
	  SFCB can use a cache mechanism to reduce the reads in the ATE region.
	  When a cache size bigger than 1 is selected a read in the ATE region
	  results in multiple ATE's being read in the ate_cache, this cache is
	  then searched for a next ate. If the cache is exhausted a next read
	  from flash is performed. The cache size is internally limited to 128
	  bytes.

config SFCB_ENABLE_CFG_CHECK
	bool "SFCB enable configuration check"
	depends on FLASH_PAGE_LAYOUT
	default y
	help
	  When SFCB mounts a file system the supplied configuration is checked.
	  This is especially good during development but takes code space. Once
	  you are sure that the configuration is good you can disable the
	  configuration check. Leave enabled if unsure.

config SFCB_FLASH_SUPPORTS_UNALIGNED_READ
	bool "SFCB flash backend supports unaligned read"
	default n
	help
	  When the flash used supports unaligned reads SFCB can use this,
	  enabling this option will reduce code. Leave disabled if unsure.

config SFCB_FLASH_SUPPORTS_UNALIGNED_WRITE
	bool "SFCB flash backend supports unaligned write"
	default n
	help
	  When the flash used supports unaligned writes SFCB can use this,
	  enabling this option will reduce code. Leave disabled if unsure.

endif # SFCB
```

## zb8/Kconfig
```kconfig
# Kconfig - zb-eight - zephyr bootloader
#
# Copyright (c) 2019 Laczen
#
# SPDX-License-Identifier: Apache-2.0
#

config ZB_EIGHT
	bool "Small secure bootloader"
	select FLASH
	help
	  Enable support of zb-eight.

if ZB_EIGHT

module = ZB_EIGHT
module-str = zb8
source "subsys/logging/Kconfig.template.log_config"

config ZB_EIGHT_IS_BOOTLOADER
	bool "Enable zb8 library for a bootloader"
	depends on ZB_EIGHT
	select TINYCRYPT
	select TINYCRYPT_SHA256
	select TINYCRYPT_ECC_DH
	select TINYCRYPT_ECC_DSA
	select TINYCRYPT_AES
	select TINYCRYPT_AES_CTR
	default n
	help
	  Enables the zb8 library to be used for a bootloader, this selects
	  items that are not used in case only zb8 support is needed.

config ZB_EIGHT_DFU_BLOCK_BUF_SIZE
	int "Image writer buffer size"
	depends on ZB_EIGHT
	range 32 4096
	default 512
	help
	  Size (in Bytes) of buffer for image writer. Must be a multiple of
	  the access alignment required by used flash driver.

config ZB_EIGHT_IS_FSL
	bool "Enable zb8 for a FSL"
	depends on ZB_EIGHT
	default n
	help
	  Enables the zb8 library to be used for a First Stage Loader.

config ZB_EIGHT_SW_VECTOR_RELAY
	bool "Enable SW VECTOR RELAY"
	default y
	depends on ARMV6_M_ARMV8_M_BASELINE && !(CPU_CORTEX_M0_HAS_VECTOR_TABLE_REMAP || CPU_CORTEX_M_HAS_VTOR)
	select SW_VECTOR_RELAY
	help
	  Enable software emulation of VTOR in case the mcu is missing a proper
	  VTOR.

endif # ZB_EIGHT
```

## zepboot/Kconfig
```kconfig
# Kconfig - ZEPboot - zephyr bootloader
#
# Copyright (c) 2019 Laczen
#
# SPDX-License-Identifier: Apache-2.0
#

config ZEPBOOT
	bool "Small secure bootloader"
	help
	  Enable support of ZEPBOOT.

if ZEPBOOT

module = ZEPBOOT
module-str = zepboot
source "subsys/logging/Kconfig.template.log_config"

config ZEPBOOT_IS_BOOTLOADER
	bool "Enable ZEPBOOT library for a bootloader"
	depends on ZEPBOOT
	default n
	help
	  Enables the ZEPBOOT library to be used for a bootloader, this selects
	  items that are not used in case only ZEPBOOT support is needed.

config ZEPBOOT_SECTOR_SIZE
	int "Sector size used during moving of images"
	depends on ZEPBOOT
	default 4096
	help
	  Size (in Bytes) of a sector. Must be a multiple of the flash page size
	  of the used flash driver. When using multiple drivers the value has to
	  be a multiple of the flash page size of all used drivers.

endif # ZEPBOOT
```

## zepboot_dfu/Kconfig
```kconfig
# Kconfig - ZEPbootdfu - dfuloader for ZEPBOOT
#
# Copyright (c) 2019 Laczen
#
# SPDX-License-Identifier: Apache-2.0
#

config ZEPBOOT_DFU
	bool "Support library for a dfu loader for ZEPBOOT"
	depends on ZEPBOOT
	help
	  Enable support of ZEPBOOT dfu loader.

if ZEPBOOT_DFU

module = ZEPBOOT_DFU
module-str = zepboot_dfu
source "subsys/logging/Kconfig.template.log_config"

config ZEPBOOT_DFU_BLOCK_BUF_SIZE
	int "Image writer buffer size"
	depends on ZEPBOOT_DFU
	default 512
	help
	  Size (in Bytes) of buffer for image writer. Must be a multiple of
	  the access alignment required by used flash driver.

config ZEPBOOT_DFU_RESET_ONLY
	bool "Enable only reset functionality for ZEPBOOT"
	depends on ZEPBOOT
	default n
	help
	  When an image is created to run from slot 1 it cannot provide loader
	  functionality, if this option is selected the image will have the
	  possibility to start the image in slot 0 and to reset the device
	  using BT.

endif # ZEPBOOT_DFU
```
